## config/boards/shields/cradio/Kconfig.defconfig
```kconfig
# overrides for various configuration settings that make sense to have different defaults when this shield is used

if SHIELD_CRADIO_LEFT
# display name of the device over USB and BLE
config ZMK_KEYBOARD_NAME
	default "Cradio"

config ZMK_SPLIT_BLE_ROLE_CENTRAL
	default y

endif

if SHIELD_CRADIO_LEFT || SHIELD_CRADIO_RIGHT

config ZMK_SPLIT
	default y

endif
```

## config/boards/shields/cradio/Kconfig.shield
```kconfig
# defines any additional Kconfig settings that may be relevant when using this keyboard

config SHIELD_CRADIO_LEFT
	def_bool $(shields_list_contains,cradio_left)

config SHIELD_CRADIO_RIGHT
	def_bool $(shields_list_contains,cradio_right)
```
